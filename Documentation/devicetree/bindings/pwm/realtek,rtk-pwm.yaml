## Documentation/devicetree/bindings/pwm/realtek,rtk-pwm.yaml
```yaml
# SPDX-License-Identifier: (GPL-2.0-only OR BSD-2-Clause)
%YAML 1.2
---
$id: http://devicetree.org/schemas/pwm/realtek,rtk-pwm.yaml#
$schema: http://devicetree.org/meta-schemas/core.yaml#

title: Realtek STB SoC PWM controller

maintainers:
  - Eric Wang <ericwang@realtek.com>

properties:
  compatible:
    enum:
      - realtek,rtk-pwm-v1
      - realtek,rtk-pwm-v2
      - realtek,rtk-pwm-v3

  reg:
    maxItems: 1

  "#pwm-cells":
    const: 2

  realtek,iso:
    description: phandle to the iso registers
    $ref: "/schemas/types.yaml#/definitions/phandle-array"

if:
  properties:
    compatible:
      contains:
        enum:
          - realtek,rtk-pwm-v1
          - realtek,rtk-pwm-v2

then:
  properties:
    num-pwm:
      description:
        Number of PWM channels
      $ref: /schemas/types.yaml#/definitions/uint32
      minimum: 1
      maximum: 4

else:
  properties:
    num-pwm:
      description:
        Number of PWM channels
      $ref: /schemas/types.yaml#/definitions/uint32
      minimum: 1
      maximum: 7

required:
  - compatible
  - reg

patternProperties:
  "^pwm_[0-6]$":
    description:
      Each PWM channel is configured as a subnode.

    properties:
      enable:
        description:
          0:disable
          1:enable
          2:inherit
          3:isolate
        $ref: /schemas/types.yaml#/definitions/uint32
        minimum: 0
        maximum: 3

      clkout_div:
        description:
          default output clock divisor
        $ref: /schemas/types.yaml#/definitions/uint32
        minimum: 0
        maximum: 255

      clksrc_div:
        description:
          default clock source divisor
        $ref: /schemas/types.yaml#/definitions/uint32
        minimum: 0
        maximum: 15

      duty_rate:
        description:
          default duty rate of PWM
        $ref: /schemas/types.yaml#/definitions/uint32
        minimum: 0
        maximum: 100

    required:
      - enable
      - clkout_div
      - clksrc_div
      - duty_rate

additionalProperties: false

examples:
  - |
    pwm: pwm@cc {
      compatible = "realtek,rtk-pwm-v2";
      #pwm-cells = <2>;
      reg = <0xcc 0x10>;
      realtek,iso = <&iso>;
      status = "disabled";

      pwm_0 {
        enable = <0>;
        clkout_div = <0xff>;
        clksrc_div = <0x1>;
        duty_rate = <50>;
      };
    };
```
