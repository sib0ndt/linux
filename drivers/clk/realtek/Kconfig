## drivers/clk/realtek/Kconfig
```kconfig
config COMMON_CLK_REALTEK
	bool "Clock driver for realtek"
	select RTK_MMIO 
	select RESET_CONTROLLER

config COMMON_CLK_REALTEK_DEBUG
	bool "Clock debug"
	select RTK_REGISTER_TRACKER
	default y
	help
	  Add a simple register tracker to clock

config COMMON_CLK_RTD1619
	bool "Clock driver for RTD1619"
	select COMMON_CLK_REALTEK
	default y

config COMMON_CLK_DUMMY
	bool "Dummy Clock"
	help
	  Dummy Clock, if not sure say N.

config RESET_MUX
	bool "Reset Controller Mux"
	default y
	help
	  A mux to select reset controll.
```

## drivers/dma-buf/heaps/Kconfig
```kconfig
config DMABUF_HEAPS_SYSTEM
	bool "DMA-BUF System Heap"
	depends on DMABUF_HEAPS
	help
	  Choose this option to enable the system dmabuf heap. The system heap
	  is backed by pages from the buddy allocator. If in doubt, say Y.

config DMABUF_HEAPS_CMA
	bool "DMA-BUF CMA Heap"
	depends on DMABUF_HEAPS && DMA_CMA
	help
	  Choose this option to enable dma-buf CMA heap. This heap is backed
	  by the Contiguous Memory Allocator (CMA). If your system has these
	  regions, you should say Y here.

config DMABUF_HEAPS_REALTEK
	tristate "DMA-BUF Realtek Heap"
	depends on DMABUF_HEAPS && DMA_CMA
	select DMA_OPS
	help
	  Choose this option to enable dma-buf Realtek heap. This heap is backed
	  by the Contiguous Memory Allocator (CMA) & Reserved Memory for Realtek
	  Platform.
```

## drivers/soc/realtek/Kconfig
```kconfig
menu "Realtek Soc Drivers"

config REALTEK_CHIP
	tristate "Realtek 1xxx chip info"
	depends on ARCH_REALTEK
	help
	  This driver provides realtek chip info.

config RTK_FAN
	tristate "RTK Fan driver"
	default n
	help
	  Realtek Fan driver
	  
endmenu
```
